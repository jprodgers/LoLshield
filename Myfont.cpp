/*simple lol shield text lib toprovide full ascii charset. written by Michael Schwarzer
 * TODO: make gplv3 pls!
 * 
 * 
 * if you dont like the font type write your own and share!!!
 * just leave those codes blank ( 0x00 0x00 0x00 0x00 0x00) that arent used!
 * 
 */




#include <avr/pgmspace.h>

#include "Myfont.h"
#include "Charliplexing.h"
#include "Arduino.h"
#include <inttypes.h>

const byte la[][5] PROGMEM = {
    /*all ascii codes:*/
		{0x00,0x00,0x00,0x00,0x00}, /* ASCII-Code 0x0 => Blank */
		{0x33,0x00,0x00,0x00,0x00}, /* ASCII-Code 0x1 => Blank */
		{0x00,0x00,0x00,0x00,0x00}, /* ASCII-Code 0x2 => Blank */
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		{0x08,0x1C,0x2A,0x08,0x08}}; /* ASCII-Code 0x7F => <- */
void Myfont::Draw(int xval, unsigned char chr) /*draws an ascii char to the screen using the given x value */
{
    uint8_t mode = LedSign::DisplayMode();
	uint8_t vr=0;
    vr=chr;
    for(uint8_t i=0; i<5; i++)
    {
        uint8_t mask = 0x01;  /*bitmask used to select the different bits from the values in the table*/
        for(uint8_t j=0; j<7; j++)
        {
            
            uint8_t tmps=pgm_read_byte( &la[vr][i] )&mask; /*read a value from the table and do a & with the mask*/
            if(tmps==mask) /*if there was a 1 set tmps to 1 else set it to 0*/
            {
                if (mode == GRAYSCALE) tmps=7;
				else tmps=1;
            }
            else
            {
                tmps=0;
            }
            if(xval+i<14 && (xval+i) >(-1)){ /*only write x vals that are existing on the screen*/
                LedSign::Set(xval+i, j+1, tmps); /*write it*/
            }
            mask <<= 1; /*take the next bit of the val from the table*/
        }
    }
}

void Myfont::Banner(int len, unsigned char* text){ /* text banner creator. use with example code!!*/
    
    
    int xoff=14;/* setmx offset to the right end of the screen*/
    for(int i=0; i<len*5 +52; i++){ /*scrolling loop*/
        for(int j=0; j<len; j++){ /*loop over all of the chars in the text*/
            Myfont::Draw(xoff + j*6, text[j]); /* call the draw font function*/
        }
        xoff--; /* decrement x offset*/
        delay(70); /*scrolling speed increments if delay goes down*/
        LedSign::Clear(); /*empty the screen */
    }
    
    
}
